## main/Kconfig.projbuild
```kconfig
menu "DAWKnob Configuration"

    config DAWKNOB_WIFI_SSID
        string "WiFi SSID"
        default "your_ssid_here"
        help
            SSID (network name) for the OTA WiFi connection.

    config DAWKNOB_WIFI_PASSWORD
        string "WiFi Password"
        default "your_password_here"
        help
            WiFi password for the OTA WiFi connection.

    config DAWKNOB_STATIC_IP
        string "Static IP Address"
        default "192.168.1.103"
        help
            Static IP address for the device on the local network.

    config DAWKNOB_GATEWAY_IP
        string "Gateway IP Address"
        default "192.168.1.254"
        help
            Gateway/router IP address.

endmenu
```

## sdkconfig.defaults
```kconfig
# DAWKnob IDF - Default Configuration
# Generated for ESP32 with Bluedroid BLE HID + WiFi OTA

# Bluetooth
CONFIG_BT_ENABLED=y
CONFIG_BT_BLE_42_FEATURES_SUPPORTED=y
# CONFIG_BT_BLE_50_FEATURES_SUPPORTED is not set

# Partition table - custom CSV with 1.5MB OTA slots for large BT+WiFi binary
CONFIG_PARTITION_TABLE_CUSTOM=y
CONFIG_PARTITION_TABLE_CUSTOM_FILENAME="partitions.csv"

# Log level
CONFIG_LOG_DEFAULT_LEVEL_INFO=y

# FreeRTOS tick rate (needed for accurate delays)
CONFIG_FREERTOS_HZ=1000

# Flash size — two-OTA partition table requires at least 4MB
CONFIG_ESPTOOLPY_FLASHSIZE_4MB=y
```
